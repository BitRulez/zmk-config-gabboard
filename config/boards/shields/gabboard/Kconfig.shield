## config/boards/shields/gabboard/Kconfig.shield
```kconfig
config SHIELD_GABBOARD_LEFT
    def_bool $(shields_list_contains,gabboard_left)
config SHIELD_GABBOARD_RIGHT
    def_bool $(shields_list_contains,gabboard_right)
```
